## config/boards/shields/chocowi36/Kconfig.defconfig
```kconfig
# Copyright (c) 2020 The ZMK Contributors
# SPDX-License-Identifier: MIT

if SHIELD_CHOCOWI36_DONGLE

config ZMK_KEYBOARD_NAME
	default "chocowi36 Dongle"
	
config ZMK_SPLIT_BLE_ROLE_CENTRAL
	default y
	
config ZMK_USB
	default y

endif

if SHIELD_CHOCOWI36_LEFT || SHIELD_CHOCOWI36_RIGHT || SHIELD_CHOCOWI36_DONGLE 

config ZMK_SPLIT
	default y

config ZMK_BLE
	default y
	
endif
```

## config/boards/shields/chocowi36/Kconfig.shield
```kconfig
# Copyright (c) 2020 The ZMK Contributors
# SPDX-License-Identifier: MIT

config SHIELD_CHOCOWI36_LEFT
	def_bool $(shields_list_contains,chocowi36_left)

config SHIELD_CHOCOWI36_RIGHT
	def_bool $(shields_list_contains,chocowi36_right)

config SHIELD_CHOCOWI36_DONGLE
	def_bool $(shields_list_contains,chocowi36_dongle)
```
